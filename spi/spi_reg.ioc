# file: spi_reg.ioc
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Mcu.Family=STM32F1
Mcu.Name=STM32F103C(8-B)Tx
Mcu.Package=LQFP48
NVIC.PriorityGroup=NVIC_PRIORITYGROUP_4
ProjectManager.HeapSize=0x200
ProjectManager.StackSize=0x400
ProjectManager.TargetToolchain=STM32CubeIDE
RCC.APB1Freq_Value=8000000
RCC.APB2Freq_Value=8000000
VP_SYS_VS_ND.Mode=No_Debug
board=custom

// file: Core/Src/main.c
/* USER CODE BEGIN Header */
/**
  ******************************************************************************
  * @file           : main.c
  * @brief          : Main program body
  ******************************************************************************
  * @attention
  *
  * <h2><center>&copy; Copyright (c) 2026 STMicroelectronics.
  * All rights reserved.</center></h2>
  *
  * This software component is licensed by ST under BSD 3-Clause license,
  * the "License"; You may not use this file except in compliance with the
  * License. You may obtain a copy of the License at:
  *                        opensource.org/licenses/BSD-3-Clause
  *
  ******************************************************************************
  */
/* USER CODE END Header */
#include "main.h"

/* USER CODE BEGIN PV */
void spi_active_slave(){
	uint32_t *ODR = (uint32_t *)(0x40010800 + 0x0c);
	//set low for PA4
	*ODR &= ~ (1 << 4);
}
void spi_inactive_slave(){
	uint32_t *ODR = (uint32_t *)(0x40010800 + 0x0c);
	//set high for PA4
	*ODR |= (1 << 4);
}
void spi_init(){
	__HAL_RCC_GPIOA_CLK_ENABLE();
	uint32_t *CRL = (uint32_t*)(0x40010800);
	*CRL &= ~(0b11 << 18); //set output pushpull for PA4
	*CRL &= ~(0b11 << 22);
	*CRL &= ~(0b11 << 26);
	*CRL &= ~(0b11 << 30);
	*CRL |= (0b10 << 22) | (0b10 << 30); //Set PA5 SCK, PA7 MOSI
	*CRL |= (0b10 << 26); //Set input pullup PA6
	uint32_t * AFIO_MAPR = (uint32_t *)(0x40010000 + 0x04);
	*AFIO_MAPR &= ~(1 << 0); //set PA4 CSS, PA5 SCK, PA6 MISO, PA7 MOSI in AFIO
	__HAL_RCC_SPI1_CLK_ENABLE();
	uint32_t * SPI1_CR1 =(uint32_t *)(0x40013000);
	*SPI1_CR1 |= (1 << 2); //set master mode
	*SPI1_CR1 |= (0b100 << 3);
	*SPI1_CR1 |= (1 << 8) | (1 << 9); //SS pin controlled by gpio
	*SPI1_CR1 |= (1 << 6); //enable pheripheral
	spi_inactive_slave();

}

char spi_read_data(char reg){
	spi_active_slave();
	uint32_t *	SPI_SR = (uint32_t *)(0x40013000 + 0x08);
	uint32_t *	SPI_DR = (uint32_t *)(0x40013000 + 0x0c);
	//send reg to slave - WRITE reg value to DR of SPI1
	while(((*SPI_SR >> 1) & 1) != 1); // Wait until the TX buffer empty
	*SPI_DR = reg;
	while(((*SPI_SR >> 1) & 1) == 1); //Wait until the data transfered to the TX buffer
	while(((*SPI_SR >> 0) & 1) != 1); //Wait RXNE not empty (has received data)
	while(((*SPI_SR >> 7) & 1) == 1); //Wait until SPI not busy
	//Clear spam data - read data from DR
	uint8_t temp = *SPI_DR;
	//send clock for slave
	while(((*SPI_SR >> 1) & 1) != 1); // Wait until the TX buffer empty
	*SPI_DR = 0xFF;
	while(((*SPI_SR >> 1) & 1) == 1); //Wait until the data transfered to the TX buffer
	while(((*SPI_SR >> 0) & 1) != 1); //Wait RXNE not empty (has received data)
	while(((*SPI_SR >> 7) & 1) == 1); //Wait until SPI not busy
	//Read data from DR
	temp = *SPI_DR;
	//inactive slave - Set PA4 to HIGH
	spi_inactive_slave();
	return temp;

}

void spi_write_data(char reg, char data){
	spi_active_slave();
	uint32_t *	SPI_SR = (uint32_t *)(0x40013000 + 0x08);
	uint32_t *	SPI_DR = (uint32_t *)(0x40013000 + 0x0c);

	//send reg to slave - WRITE reg value to DR of SPI1
	while(((*SPI_SR >> 1) & 1) != 1); // Wait until the TX buffer empty
	*SPI_DR = reg;
	while(((*SPI_SR >> 1) & 1) == 1); //Wait until the data transfered to the TX buffer
	while(((*SPI_SR >> 0) & 1) != 1); //Wait RXNE not empty (has received data)
	while(((*SPI_SR >> 7) & 1) == 1); //Wait until SPI not busy
	uint8_t t = *SPI_DR;
	//send clock for slave
	while(((*SPI_SR >> 1) & 1) != 1); // Wait until the TX buffer empty
	*SPI_DR = data;
	while(((*SPI_SR >> 1) & 1) == 1); //Wait until the data transfered to the TX buffer
	while(((*SPI_SR >> 0) & 1) != 1); //Wait RXNE not empty (has received data)
	//Read data from DR
	t = *SPI_DR;
	//inactive slave - Set PA4 to HIGH
	spi_inactive_slave();
}
/* USER CODE END PV */

void SystemClock_Config(void);

int main(void)
{

  /* MCU Configuration--------------------------------------------------------*/

  /* Reset of all peripherals, Initializes the Flash interface and the Systick. */
  HAL_Init();

  /* Configure the system clock */
  SystemClock_Config();

  /* Initialize all configured peripherals */
  /* USER CODE BEGIN 2 */
  spi_init();
  /* USER CODE END 2 */

  /* Infinite loop */
  /* USER CODE BEGIN WHILE */
  while (1)
  {
	  spi_read_data(0x80);
	  HAL_Delay(1000);
    /* USER CODE END WHILE */

  }
}

void SystemClock_Config(void)
{
  RCC_OscInitTypeDef RCC_OscInitStruct = {0};
  RCC_ClkInitTypeDef RCC_ClkInitStruct = {0};

  /** Initializes the RCC Oscillators according to the specified parameters
  * in the RCC_OscInitTypeDef structure.
  */
  RCC_OscInitStruct.OscillatorType = RCC_OSCILLATORTYPE_HSI;
  RCC_OscInitStruct.HSIState = RCC_HSI_ON;
  RCC_OscInitStruct.HSICalibrationValue = RCC_HSICALIBRATION_DEFAULT;
  RCC_OscInitStruct.PLL.PLLState = RCC_PLL_NONE;
  if (HAL_RCC_OscConfig(&RCC_OscInitStruct) != HAL_OK)
  {
    Error_Handler();
  }
  /** Initializes the CPU, AHB and APB buses clocks
  */
  RCC_ClkInitStruct.ClockType = RCC_CLOCKTYPE_HCLK|RCC_CLOCKTYPE_SYSCLK
                              |RCC_CLOCKTYPE_PCLK1|RCC_CLOCKTYPE_PCLK2;
  RCC_ClkInitStruct.SYSCLKSource = RCC_SYSCLKSOURCE_HSI;
  RCC_ClkInitStruct.AHBCLKDivider = RCC_SYSCLK_DIV1;
  RCC_ClkInitStruct.APB1CLKDivider = RCC_HCLK_DIV1;
  RCC_ClkInitStruct.APB2CLKDivider = RCC_HCLK_DIV1;

  if (HAL_RCC_ClockConfig(&RCC_ClkInitStruct, FLASH_LATENCY_0) != HAL_OK)
  {
    Error_Handler();
  }
}

void Error_Handler(void)
{
  __disable_irq();
  while (1)
  {
  }
}

/************************ (C) COPYRIGHT STMicroelectronics *****END OF FILE****/
