# file: Flash.ioc
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Mcu.Family=STM32F1
Mcu.Name=STM32F103C(8-B)Tx
Mcu.Package=LQFP48
NVIC.PriorityGroup=NVIC_PRIORITYGROUP_4
PA13.Mode=Serial_Wire
PA13.Signal=SYS_JTMS-SWDIO
PA14.Mode=Serial_Wire
PA14.Signal=SYS_JTCK-SWCLK
ProjectManager.HeapSize=0x200
ProjectManager.StackSize=0x400
ProjectManager.TargetToolchain=STM32CubeIDE
RCC.APB1Freq_Value=8000000
RCC.APB2Freq_Value=8000000
board=custom

// file: Core/Src/main.c
/* USER CODE BEGIN Header */
/**
  ******************************************************************************
  * @file           : main.c
  * @brief          : Main program body
  ******************************************************************************
  * @attention
  *
  * <h2><center>&copy; Copyright (c) 2026 STMicroelectronics.
  * All rights reserved.</center></h2>
  *
  * This software component is licensed by ST under BSD 3-Clause license,
  * the "License"; You may not use this file except in compliance with the
  * License. You may obtain a copy of the License at:
  *                        opensource.org/licenses/BSD-3-Clause
  *
  ******************************************************************************
  */
/* USER CODE END Header */
#include "main.h"

/* USER CODE BEGIN PV */
void Flash_Erase(uint32_t page){
	uint32_t* FLASH_CR = (uint32_t*)(0x40022000 + 0x10);
	uint32_t* FLASH_SR = (uint32_t*)(0x40022000 + 0x0c);
	uint32_t* FLASH_AR = (uint32_t*)(0x40022000 + 0x14);
  	uint32_t* FLASH_KEYR = (uint32_t*)(0x40022000 + 0x04);

	while(((*FLASH_SR >> 0) & 1) == 1); //Check no main Flash memory operation is ongoing by checking the BSY bit
	*FLASH_CR = (1 << 1); //Page Erase.
  	if(((*FLASH_CR >> 7) & 1) == 1){
    	*FLASH_KEYR =  0x45670123;
    	*FLASH_KEYR =  0xCDEF89AB;
  }
  	*FLASH_AR = page; //Erase page 0
  	*FLASH_CR |= (1 << 6);  //trigger erase operation
  	while(((*FLASH_SR >> 0) & 1) == 1); //wait for BSY reset
  	*FLASH_CR &= ~(1 << 6);
}

void Flash_Program(uint8_t* add, uint8_t value){
 	uint32_t* FLASH_SR = (uint32_t*)(0x40022000 + 0x0c);
 	uint32_t* FLASH_CR = (uint32_t*)(0x40022000 + 0x10);
 	uint32_t* FLASH_KEYR = (uint32_t*)(0x40022000 + 0x04);

	while(((*FLASH_SR >> 0) & 1) == 1); //Check no main Flash memory operation is ongoing by checking the BSY bit

  	if(((*FLASH_CR >> 7) & 1) == 1){
    	*FLASH_KEYR =  0x45670123;
    	*FLASH_KEYR =  0xCDEF89AB;
  	}

  	*FLASH_CR |= (1 << 0); //Flash programming
	add = value;
  	while(((*FLASH_SR >> 0) & 1) == 1); //wait for BSY reset

}
/* USER CODE END PV */

void SystemClock_Config(void);
static void MX_GPIO_Init(void);

int main(void)
{

  /* MCU Configuration--------------------------------------------------------*/

  /* Reset of all peripherals, Initializes the Flash interface and the Systick. */
  HAL_Init();

  /* Configure the system clock */
  SystemClock_Config();

  /* Initialize all configured peripherals */
  MX_GPIO_Init();

  /* Infinite loop */
  while (1)
  {

  }
}

void SystemClock_Config(void)
{
  RCC_OscInitTypeDef RCC_OscInitStruct = {0};
  RCC_ClkInitTypeDef RCC_ClkInitStruct = {0};

  /** Initializes the RCC Oscillators according to the specified parameters
  * in the RCC_OscInitTypeDef structure.
  */
  RCC_OscInitStruct.OscillatorType = RCC_OSCILLATORTYPE_HSI;
  RCC_OscInitStruct.HSIState = RCC_HSI_ON;
  RCC_OscInitStruct.HSICalibrationValue = RCC_HSICALIBRATION_DEFAULT;
  RCC_OscInitStruct.PLL.PLLState = RCC_PLL_NONE;
  if (HAL_RCC_OscConfig(&RCC_OscInitStruct) != HAL_OK)
  {
    Error_Handler();
  }
  /** Initializes the CPU, AHB and APB buses clocks
  */
  RCC_ClkInitStruct.ClockType = RCC_CLOCKTYPE_HCLK|RCC_CLOCKTYPE_SYSCLK
                              |RCC_CLOCKTYPE_PCLK1|RCC_CLOCKTYPE_PCLK2;
  RCC_ClkInitStruct.SYSCLKSource = RCC_SYSCLKSOURCE_HSI;
  RCC_ClkInitStruct.AHBCLKDivider = RCC_SYSCLK_DIV1;
  RCC_ClkInitStruct.APB1CLKDivider = RCC_HCLK_DIV1;
  RCC_ClkInitStruct.APB2CLKDivider = RCC_HCLK_DIV1;

  if (HAL_RCC_ClockConfig(&RCC_ClkInitStruct, FLASH_LATENCY_0) != HAL_OK)
  {
    Error_Handler();
  }
}

static void MX_GPIO_Init(void)
{

  /* GPIO Ports Clock Enable */
  __HAL_RCC_GPIOA_CLK_ENABLE();

}

void Error_Handler(void)
{
  __disable_irq();
  while (1)
  {
  }
}

/************************ (C) COPYRIGHT STMicroelectronics *****END OF FILE****/
