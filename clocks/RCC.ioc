# file: RCC.ioc
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Mcu.Family=STM32F1
Mcu.Name=STM32F103C(8-B)Tx
Mcu.Package=LQFP48
NVIC.PriorityGroup=NVIC_PRIORITYGROUP_4
PA13.Mode=Serial_Wire
PA13.Signal=SYS_JTMS-SWDIO
PA14.Mode=Serial_Wire
PA14.Signal=SYS_JTCK-SWCLK
ProjectManager.HeapSize=0x200
ProjectManager.StackSize=0x400
ProjectManager.TargetToolchain=STM32CubeIDE
RCC.APB1Freq_Value=8000000
RCC.APB2Freq_Value=8000000
board=custom

// file: Core/Src/main.c
/* USER CODE BEGIN Header */
/**
  ******************************************************************************
  * @file           : main.c
  * @brief          : Main program body
  ******************************************************************************
  * @attention
  *
  * <h2><center>&copy; Copyright (c) 2026 STMicroelectronics.
  * All rights reserved.</center></h2>
  *
  * This software component is licensed by ST under BSD 3-Clause license,
  * the "License"; You may not use this file except in compliance with the
  * License. You may obtain a copy of the License at:
  *                        opensource.org/licenses/BSD-3-Clause
  *
  ******************************************************************************
  */
/* USER CODE END Header */
#include "main.h"

/* USER CODE BEGIN PV */
typedef enum{
	TIM2_pheripheral = 0,
	TIM3_pheripheral,
	TIM4_pheripheral,
	TIM5_pheripheral,
	TIM6_pheripheral,
	TIM7_pheripheral,
	TIM12_pheripheral,
	TIM13_pheripheral,
	TIM14_pheripheral,
	Watchdog_pheripheral = 11,
	SPI2_pheripheral = 14,
	SPI3_pheripheral,
	Usart2_pheripheral = 17,
	Usart3_pheripheral,
	Usart4_pheripheral,
	Usart5_pheripheral,
	i2c1_pheripheral,
	i2c2_pheripheral,
	usb_pheripheral,
	can_pheripheral = 25,
	backup_pheripheral = 27,
	power_pheripheral,
	dac_pheripheral
}APB1_Pheripheral;

/* USER CODE END PV */

void SystemClock_Config(void);
static void MX_GPIO_Init(void);
/* USER CODE BEGIN PFP */
void clock_init(){
	uint32_t* RCC_CR = (uint32_t*)(0x40021000);
	uint32_t* RCC_CFGR = (uint32_t*)(0x40021000 + 0x04);
	uint32_t* RCC_AHBENR = (uint32_t*)(0x40021000 + 0x14);

	*RCC_CR |= (1 << 0); //enable HSI Clock
	while(((*RCC_CR >> 1) & 1) != 1); //wait HSI ready

	*RCC_CFGR &= ~(1 << 16); // HSI oscillator clock selected as PLL input clock
	*RCC_CFGR &= ~(0b1111 << 18); //PLL input clock x 2 ==> 8Mhz
	*RCC_CFGR &= ~(0b1111 << 4); //AHB prs not divided ==> 8Mhz
	*RCC_CFGR &= ~(0b111 << 8);  //ABP1 not divided ==> 8MHz
	*RCC_CFGR &= ~(0b111 << 11); //ABP2 not divided ==> 8MHz

	*RCC_CR |= (1 << 24);	//enable PLL
	while(((*RCC_CR >> 25) & 1) != 1); //wait PLL ready

	*RCC_CFGR &= ~(0b1111 << 0);
	*RCC_CFGR |= (0b10 << 0); //PLL selected as system clock

	while(((*RCC_CFGR >> 2) & 0b11) != 0b10); //wait until PLL is set as sys clock

}

void clock_enable_ABP1(APB1_Pheripheral *p){
	uint32_t* RCC_APB1RSTR = (uint32_t*)(0x40021000 + 0x10);
	*RCC_APB1RSTR |= (1 << *p);
}

/* USER CODE END PFP */

int main(void)
{

  /* MCU Configuration--------------------------------------------------------*/

  /* Reset of all peripherals, Initializes the Flash interface and the Systick. */
  HAL_Init();

  /* Configure the system clock */
  SystemClock_Config();

  /* Initialize all configured peripherals */
  MX_GPIO_Init();

  /* Infinite loop */
  while (1)
  {

  }
}

void SystemClock_Config(void)
{
  RCC_OscInitTypeDef RCC_OscInitStruct = {0};
  RCC_ClkInitTypeDef RCC_ClkInitStruct = {0};

  /** Initializes the RCC Oscillators according to the specified parameters
  * in the RCC_OscInitTypeDef structure.
  */
  RCC_OscInitStruct.OscillatorType = RCC_OSCILLATORTYPE_HSI;
  RCC_OscInitStruct.HSIState = RCC_HSI_ON;
  RCC_OscInitStruct.HSICalibrationValue = RCC_HSICALIBRATION_DEFAULT;
  RCC_OscInitStruct.PLL.PLLState = RCC_PLL_NONE;
  if (HAL_RCC_OscConfig(&RCC_OscInitStruct) != HAL_OK)
  {
    Error_Handler();
  }
  /** Initializes the CPU, AHB and APB buses clocks
  */
  RCC_ClkInitStruct.ClockType = RCC_CLOCKTYPE_HCLK|RCC_CLOCKTYPE_SYSCLK
                              |RCC_CLOCKTYPE_PCLK1|RCC_CLOCKTYPE_PCLK2;
  RCC_ClkInitStruct.SYSCLKSource = RCC_SYSCLKSOURCE_HSI;
  RCC_ClkInitStruct.AHBCLKDivider = RCC_SYSCLK_DIV1;
  RCC_ClkInitStruct.APB1CLKDivider = RCC_HCLK_DIV1;
  RCC_ClkInitStruct.APB2CLKDivider = RCC_HCLK_DIV1;

  if (HAL_RCC_ClockConfig(&RCC_ClkInitStruct, FLASH_LATENCY_0) != HAL_OK)
  {
    Error_Handler();
  }
}

static void MX_GPIO_Init(void)
{

  /* GPIO Ports Clock Enable */
  __HAL_RCC_GPIOA_CLK_ENABLE();

}

void Error_Handler(void)
{
  __disable_irq();
  while (1)
  {
  }
}

/************************ (C) COPYRIGHT STMicroelectronics *****END OF FILE****/
